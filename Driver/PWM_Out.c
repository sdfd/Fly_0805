#include "PWM_Out.h"

void Tim_Pwm_Out_Init(void)
{
	ROM_SysCtlPeripheralEnable(SYSCTL_PERIPH_GPIOH);
//	ROM_SysCtlPeripheralEnable(SYSCTL_PERIPH_GPIOM);
	ROM_SysCtlPeripheralEnable(SYSCTL_PERIPH_PWM0);
	
	ROM_SysCtlDelay(3);
	
	ROM_SysCtlPWMClockSet(SYSCTL_PWMDIV_64);	
	ROM_GPIOPinConfigure(GPIO_PH0_M0PWM0);
	ROM_GPIOPinConfigure(GPIO_PH1_M0PWM1);
	ROM_GPIOPinConfigure(GPIO_PH2_M0PWM2);
	ROM_GPIOPinConfigure(GPIO_PH3_M0PWM3);
	ROM_GPIOPinTypePWM(GPIO_PORTH_BASE, GPIO_PIN_0 );
	ROM_GPIOPinTypePWM(GPIO_PORTH_BASE, GPIO_PIN_1 );
	ROM_GPIOPinTypePWM(GPIO_PORTH_BASE, GPIO_PIN_2 );
	ROM_GPIOPinTypePWM(GPIO_PORTH_BASE, GPIO_PIN_3 );
	ROM_PWMGenConfigure(PWM0_BASE, PWM_GEN_0, PWM_GEN_MODE_DOWN | PWM_GEN_MODE_NO_SYNC);
	ROM_PWMGenPeriodSet(PWM0_BASE, PWM_GEN_0, 25000); //Down ģʽ���65535 Up_Downģʽ���Ϊ2*65535
	ROM_PWMPulseWidthSet(PWM0_BASE, PWM_OUT_0,1250);//ROM_PWMGenPeriodGet(PWM0_BASE, PWM_OUT_0) / 10);
	ROM_PWMPulseWidthSet(PWM0_BASE, PWM_OUT_1,1250);//ROM_PWMGenPeriodGet(PWM0_BASE, PWM_OUT_0) / 10);
	ROM_PWMGenConfigure(PWM0_BASE, PWM_GEN_1, PWM_GEN_MODE_DOWN | PWM_GEN_MODE_NO_SYNC);
	ROM_PWMGenPeriodSet(PWM0_BASE, PWM_GEN_1, 25000); //Down ģʽ���65535 Up_Downģʽ���Ϊ2*65535
	ROM_PWMPulseWidthSet(PWM0_BASE, PWM_OUT_2,1250);//ROM_PWMGenPeriodGet(PWM0_BASE, PWM_OUT_0) / 10);
	ROM_PWMPulseWidthSet(PWM0_BASE, PWM_OUT_3,1250);//ROM_PWMGenPeriodGet(PWM0_BASE, PWM_OUT_0) / 10);
	ROM_PWMOutputState(PWM0_BASE, PWM_OUT_0_BIT | PWM_OUT_1_BIT | PWM_OUT_2_BIT | PWM_OUT_3_BIT, true);
	ROM_PWMGenEnable(PWM0_BASE, PWM_GEN_0);
	ROM_PWMGenEnable(PWM0_BASE, PWM_GEN_1);
}


void Moto_PwmRflash(int32_t MOTO1_PWM,int32_t MOTO2_PWM,int32_t MOTO3_PWM,int32_t MOTO4_PWM)
{
	if(MOTO1_PWM>Moto_PwmMax)	MOTO1_PWM = Moto_PwmMax;
	if(MOTO2_PWM>Moto_PwmMax)	MOTO2_PWM = Moto_PwmMax;
	if(MOTO3_PWM>Moto_PwmMax)	MOTO3_PWM = Moto_PwmMax;
	if(MOTO4_PWM>Moto_PwmMax)	MOTO4_PWM = Moto_PwmMax;
	if(MOTO1_PWM<0)	MOTO1_PWM = Moto_PwmMin;
	if(MOTO2_PWM<0)	MOTO2_PWM = Moto_PwmMin;
	if(MOTO3_PWM<0)	MOTO3_PWM = Moto_PwmMin;
	if(MOTO4_PWM<0)	MOTO4_PWM = Moto_PwmMin;
	ROM_PWMPulseWidthSet(PWM0_BASE, PWM_OUT_0,MOTO1_PWM*1.25+1250);
	ROM_PWMPulseWidthSet(PWM0_BASE, PWM_OUT_1,MOTO2_PWM*1.25+1250);
	ROM_PWMPulseWidthSet(PWM0_BASE, PWM_OUT_2,MOTO3_PWM*1.25+1250);
	ROM_PWMPulseWidthSet(PWM0_BASE, PWM_OUT_3,MOTO4_PWM*1.25+1250);
}

